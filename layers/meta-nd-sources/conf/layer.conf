## layers/meta-nd-sources/conf/layer.conf
```bitbake
# We have a conf and classes directory, add to BBPATH
BBPATH .= ":${LAYERDIR}"

# We have recipes-* directories, add to BBFILES
BBFILES += "${LAYERDIR}/recipes-*/*/*.bb \
            ${LAYERDIR}/recipes-*/*/*.bbappend"

BBFILE_COLLECTIONS += "meta-nd-sources"
BBFILE_PATTERN_meta-nd-sources = "^${LAYERDIR}/"
BBFILE_PRIORITY_meta-nd-sources = "6"

LAYERDEPENDS_meta-nd-sources = "core"
LAYERSERIES_COMPAT_meta-nd-sources = "kirkstone"
```
